/ {
    /* We may want to move this to /devices some day */
    interrupt_controller: interrupt_controller {
        interrupt-controller;
        /* interrupt-cells *must* be 1.
         * Other values are not supported by the kernel.
         */
        #interrupt-cells = <1>;
    };

    devices {
        interrupt-parent = <&interrupt_controller>;
    };

    rees {
        interrupt-parent = <&interrupt_controller>;
    };
};
